// 3 phase PWM sine
// (c) 2016 C. Masenas
// ดัดแปลงเพิ่มเติม จากต้นฉับ DDS generator ของ KHM 2009 /  Martin Nawrath
// Modified Y2018 By Seree2004
// Modified Y2018 By Narong Kongsin

#include <LiquidCrystal.h>		//เรียกโปรแกรมคำสั่งการใช้งานจอแสดงผล LCD เข้ามาร่วมด้วย

// ตารางการวาดรูปสัญญาณซายเวฟ แบ่งระดับความสูงของสัญญานเป็น 5 ส่วน และสัญญาณละ 256  จุดรวม 1280 จุด
PROGMEM const unsigned char Sine_Table[1280]  = {
 64, 65, 67, 68, 70, 71, 73, 74, 76, 77, 79, 81, 82, 83, 85, 86, 88, 89, 91, 92, 94, 95, 96, 98, 99,100,101,103,104,105,106,107,
109,110,111,112,113,114,115,116,116,117,118,119,120,120,121,122,122,123,123,124,124,125,125,126,126,126,126,127,127,127,127,127,
127,127,127,127,127,126,126,126,126,125,125,125,124,124,123,123,122,121,121,120,119,118,118,117,116,115,114,113,112,111,110,109,
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 20, 21, 22, 23, 24, 26, 27, 28, 29, 31, 32, 33, 35, 36, 38, 39, 41, 42, 44, 45, 46, 48, 50, 51, 53, 54, 56, 57, 59, 60, 62, 64,

//Amplitude_159
 80, 81, 83, 85, 87, 89, 91, 93, 95, 97, 99,101,103,105,106,108,110,112,114,115,117,119,121,122,124,125,127,129,130,132,133,134,
136,137,139,140,141,142,144,145,146,147,148,149,150,151,152,152,153,154,154,155,156,156,157,157,158,158,158,158,159,159,159,159,
159,159,159,159,159,158,158,158,157,157,156,156,155,155,154,153,153,152,151,150,149,148,147,146,145,144,143,142,141,139,138,137,
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 25, 26, 27, 29, 30, 32, 34, 35, 37, 38, 40, 42, 44, 45, 47,49 , 51, 53, 54, 56, 58, 60, 62, 64, 66, 68, 70, 72, 74, 76, 78, 80,

//Amplitude_191
 96, 98,100,103,105,107,110,112,114,117,119,121,123,126,128,130,132,134,136,139,141,143,145,147,149,151,153,154,156,158,160,162,
163,165,166,168,170,171,172,174,175,176,178,179,180,181,182,183,184,185,186,186,187,188,188,189,189,190,190,190,191,191,191,191,
191,191,191,191,190,190,190,189,189,189,188,187,187,186,185,184,183,183,182,180,179,178,177,176,174,173,172,170,169,167,166,164,
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 29, 31, 33, 35, 37, 38, 40, 42, 44, 46, 48, 50, 52, 55, 57, 59, 61, 63, 65, 68, 70, 72, 74, 77, 79, 81, 84, 86, 88, 91, 93, 96,

//Amplitude_223
112,114,117,120,122,125,128,131,133,136,139,141,144,147,149,152,154,157,159,162,164,167,169,171,174,176,178,180,182,185,187,189,
191,192,194,196,198,200,201,203,204,206,207,209,210,211,213,214,215,216,217,218,218,219,220,220,221,221,222,222,223,223,223,223,
223,223,223,223,222,222,222,221,221,220,219,219,218,217,216,215,214,213,212,211,209,208,207,205,204,202,200,199,197,195,193,192,
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 34, 36, 38, 41, 43, 45, 47, 49, 52, 54, 56, 59, 61, 64, 66, 69, 71, 74, 76, 79, 82, 84, 87, 90, 92, 95, 98,101,103,106,109,112,

//Amplitude_240
120,123,126,129,132,135,138,141,144,146,149,152,155,158,161,163,166,169,171,174,177,179,182,184,187,189,192,194,196,199,201,203,
205,207,209,211,213,215,217,218,220,222,223,225,226,227,229,230,231,232,233,234,235,236,237,237,238,238,239,239,239,240,240,240,
240,240,240,240,239,239,239,238,238,237,236,235,235,234,233,232,231,229,228,227,225,224,222,221,219,218,216,214,212,210,208,206,
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 37, 39, 41, 44, 46, 48, 51, 53, 56, 58, 61, 63, 66, 69, 71, 74, 77, 79, 82, 85, 88, 91, 94, 96, 99,102,105,108,111,114,117,120
};

// เปลี่ยนวิธีการสั่งเซทค่าของรีจีสเตอร์ภายในของ Arduino ใหม่เพื่อให้เรียกใช้ง่ายขึ้น
#define cbi(sfr, bit) (_SFR_BYTE(sfr) &= ~_BV(bit))
#define sbi(sfr, bit) (_SFR_BYTE(sfr) |= _BV(bit))
// เปลี่ยนชื่อเรียกขาของ Arduino ใหม่เพื่อให้จำง่ายในการต่อวงจร
#define PWM_OUT_UL	6   // PWM1 UL output
#define PWM_OUT_UH	5   // PWM1 UH output
#define PWM_OUT_VL	9   // PWM2 VL output
#define PWM_OUT_VH	10  // PWM2 VH output
#define PWM_OUT_WL	11  // PWM3 WL output
#define PWM_OUT_WH	3   // PWM3 WH output
#define testPin		8	// Test OutPut เพื่อกระพริบหลอดไฟ LED
#define enablePin	13 	// เพื่อปิด/เปิดภาค Power Driver
#define single_3ph      12      //เพือตัวจั้มเปอร์ ให้เป็นแบบ ซิงเกิลเฟส หรือ แบบ 3 เฟส
#define FAULT_DETECT     2     //เพื่อตรวจรับสัญญาณผิดพลาดต่างๆจะได้ปิดภาค Power Driver ก่อนที่จะทำให้อุปกรณ์เสียหาย
#define FREQ_POT     0        // เพื่อเต่อกับวอลลุ่มปรับความถี่ analog input A0 
#define CURRENT_POT  1        // สำรองไว้  analog input A1 
// ตั้งชื่อการกำหนดค่า  DeadTime
#define DT_LOW          2   // DeadTime Low Side
#define DT_HIGH  DT_LOW*2   // DeadTime High Side
// ตั้งชื่อการกำหนดค่าของ วอลลุ่มปรับความเร็วรอบ (Hz)ต่ำสุดและสูงสุด
#define FREQ_MIN     5        // default: 5
#define FREQ_MAX     100      // default: 100
// เปลี่ยนชื่อเรียกค่าตายตัวของตัวปรับวอลลุ่มของ Arduino ซึ่งเป็นความสามารถของ MCU ในแต่ละเบอร์อาจต่างกัน
#define POT_MIN 0    // default: 0
#define POT_MAX 1023 // default: 1023  

// การตั้งชื่อตัวแปรต่าง ๆ ที่ใช้ในตัวโปรแกรม
volatile  float freq = 5;
const float refclk = 15.318  ;     //  ค่าตายตัวที่ได้มาจากการคำนวน คริสตอลที่ใช้ 16 MHz/8/510/256 = 15.318

// ตั้งชื่อตัวแปรที่ใช้ในการคำนวนรอบของสัญญาณซายเวฟและต่อเนื่องกันอย่างสมบูรณ์ interrupt service declared as voilatile
volatile unsigned long sigma;   // phase accumulator
volatile unsigned long delta;  // phase increment
//ตั้งชื่อตัวแปรต่าง ๆ
byte phase0, phase1, phase2, freq_old, freq_new,Amplitude; 
unsigned int count_test = 0;
unsigned int ADD_AMPD = 0;
bool single = false;

// ตั้งชื่อค่าตายตัวที่เรากำหนดในการต่อขาต่าง ๆ ของ Arduino เข้ากับจอ LCD เพื่อให้จำง่าย
  const int RS = 7, EN = 4, D4 = A2, D5 = A3, D6 = A4, D7 = A5;
// แล้วสั่งให้กำหนดตามนี้ได้เลย
  LiquidCrystal lcd(RS, EN, D4, D5, D6, D7);

// เริ่มต้นตัวโปรแกรมโดยคำสั่งตั้งค่าต่าง ๆ ก่อน
void setup(){
	
   pinMode(enablePin, OUTPUT);    // สั่งเซตให้เป็นขาสัญญาณออก
   pinMode(testPin, OUTPUT);      // สั่งเซตให้เป็นขาสัญญาณออก

   pinMode(single_3ph, INPUT_PULLUP);	// สั่งเซตให้เป็นขารับสัญญาณเข้า และ พูลอัพ
   pinMode(FAULT_DETECT, INPUT_PULLUP);	// สั่งเซตให้เป็นขารับสัญญาณเข้า และ พูลอัพ
   
   pinMode(PWM_OUT_UL, OUTPUT); //  สั่งเซตให้เป็นขาสัญญาณออก
   pinMode(PWM_OUT_UH, OUTPUT); // สั่งเซตให้เป็นขาสัญญาณออก
   pinMode(PWM_OUT_VL, OUTPUT); // สั่งเซตให้เป็นขาสัญญาณออก
   pinMode(PWM_OUT_VH, OUTPUT); // สั่งเซตให้เป็นขาสัญญาณออก
   pinMode(PWM_OUT_WL, OUTPUT); // สั่งเซตให้เป็นขาสัญญาณออก
   pinMode(PWM_OUT_WH, OUTPUT); // สั่งเซตให้เป็นขาสัญญาณออก
   
   digitalWrite(enablePin, LOW); // สั่งให้ขานี้ ปิด (เป็น0) เพื่อทำให้ภาค	Power Drive อย่าเพิ่งทำงานตอนนี้
   
   if (digitalRead(single_3ph) == LOW){single = true;} // ตรวจสอบว่าขาจั้มเปอร์จั้มเป็นซิงเกิลเฟสหรือเปล่า ถ้าจั้มก็บอกว่า จริง ถ้าไม่จ้ัมก็บอกว่า เท็จ
   
   lcd.begin(16,2); // เริ่มเปิดใช้งานจอแสดงผล LCD  
   lcd.setCursor(1, 0); // สังให้แสดงผลคอลั่มที่ 1 ในบรรทัดแรก (0) 
   lcd.print("   DADSEREE    "); // แสดงผล 	DADSEREE
    delay(3000);				// หน่วงเวลาให้แสดงผลนี้ เป็นเวลานาน 3 วินาที
//-----------------------------------------------------------------------------	
   if (single == true){			// ถ้าตัวจั้มเปอร์เป็นจริงก็ให้แสดงผล ที่ คอลั่ม 13 บรรทัดแรก 1PH
     lcd.setCursor(13, 0);
     lcd.print("1PH");
   } 
   else{
     lcd.setCursor(13, 0);		// หรือถ้าตัวจั้มเปอร์เป็นเท็จ ก็ให้แสดงผลที่ คอลั่ม 13 บรรทัดแรก 3PH
     lcd.print("3PH");     
   }
 //----------------------------------------------------------------------------  
   lcd.setCursor(1, 0);			// แสดงผลที่คอลั่ม 1 บรรทัด 1 คำว่า Amplitude รอไว้ก่อนเพื่อให้ค่าจริงมาต่อ
   lcd.print("Amplitude");
    lcd.setCursor(1, 1);		// แสดงผลที่คอลั่ม 1 บรรทัด 2 คำว่า Frequency รอไว้ก่อนเพื่อให้ค่าจริงมาต่อ
   lcd.print("Frequency:");
//-----------------------------------------------------------------------------
 // ไปเรียกโปรแกรมการตั้งค่า ไทม์เเมอร์ เพื่อกำหนดค่าการสร้างสัญญาณ PWM 3 ชุด โดยใช้ตัวไทม์เมอร์ของ Arduino ทั้ง 3  ตัว Setup the timers
   setup_timer0();
   setup_timer1();
   setup_timer2(); 
// ส่วนนี้เป็นการคำนวนตามสูตรเพื่อ ให้ได้สัญญาณซายเวฟครบวงรอบต่อเนื่องต้องใช้ความละเอียดถึง 32 บิต และจะได้ผลลับที่ 8 บิต สูงสุด แต่เวลาใช้งานจะต้องเลื่อนบิตกลับมาใชั 8 บิตล่าง   
  delta = (1LL<<24)*freq/refclk ;  
//----------------------------------------------------------------------------- 
// กำหนดค่าให้ตัวแปร 
  freq_new = 5;
  freq_old =0;
  changeFreq(freq);
  digitalWrite(enablePin, HIGH); // เปิด ภาค Power Drive ให้เริ่มทำงานได้
}
//-----------------------------------------------------------------------------
void loop(){
	
  freq_new = map(analogRead(FREQ_POT), POT_MIN, POT_MAX, FREQ_MIN, FREQ_MAX);
    if (freq_new != freq_old){
      changeFreq(freq_new);
      
       lcd.setCursor(11, 1);
       lcd.print(freq_new);
       lcd.print("Hz ");
       
       Amplitude = freq_new/10;     
       if (Amplitude >= 4){Amplitude = 4;}
       ADD_AMPD = 256 *  Amplitude;

       lcd.setCursor(11,0);
       lcd.print(Amplitude);
       
       freq_old = freq_new;
    } 
	
  count_test ++;
  if (count_test == 2000){count_test = 0;} 
  
  if (count_test == 0){
    digitalWrite(testPin, LOW);
   }
   
  if (count_test == 1000){
    digitalWrite(testPin, HIGH);
   }   
             
 }
//----------------------------------------------------------------------------
// ชุดคำสั่งในการเปลี่ยนความถี่
void changeFreq(float _freq){
  cbi (TIMSK2,TOIE2);              // หยุดพการทำงานของไทม์เมอร์ 2  disable timer2 overflow detect
  freq = _freq;
  delta=(1LL<<24)*freq/refclk;  // อัพเดทความถี่ใหม่  update phase increment
  sbi (TIMSK2,TOIE2);              //เปิดให้ไทม์เมอร์ 2 ทำงาน enable timer2 overflow detect
} 

//------------------------------------------------------------------------------
// ชุดคำสั่งในการตั้งค่า ไทม์เมอร์ ตัวแรก (0)
// timer0 setup
// set prescaler to 8, PWM mode to phase correct PWM, 16000000/512/8 = 3.9kHz clock
void setup_timer0(void){
// Timer0 Clock Prescaler to :ตั้งค่าไทม์เมอร์ให้ หารอีก 8 เพื่อจะได้ความถี่ PWM ขนาด 3.9 Khz ให้เหมาะกับ IPM เบอร์เก่า ๆ
   cbi (TCCR0B, CS00);
   sbi (TCCR0B, CS01);
   cbi (TCCR0B, CS02);   

// Timer0 PWM Mode set to Phase Correct PWM
   cbi (TCCR0A, COM0A0); // ตั้งค่าให้ชุดส่งสัญญาณช่อง แรก (OCR0A) ให้ส่งสัญญาณออกเป็น Sine PWM ปรกติ +
   sbi (TCCR0A, COM0A1);
   sbi (TCCR0A, COM0B0); // ตั้งค่าให้ชุดส่งสัญญาณช่อง แรก (OCR0B)  ให้ส่งสัญญาณออกเป็น Sine PWM กลับเฟส Invert เป็น -
   sbi (TCCR0A, COM0B1);
   sbi (TCCR0A, WGM00); //ตั้งค่าให้สัญญาณพัลซ์ทุกลูกอยู่แนวเดียวกันเสมอในทุกเฟส (Mode 1 / Phase Correct PWM)
   cbi (TCCR0A, WGM01);
   cbi (TCCR0B, WGM02);
}

//------------------------------------------------------------------------------
// timer1 setup
// set prescaler to 8, PWM mode to phase correct PWM, 16000000/512/8 = 3.9kHz clock ให้เหมาะกับ IPM เบอร์เก่า ๆ
void setup_timer1(void){
// Timer1 Clock Prescaler to :ตั้งค่าไทม์เมอร์ให้ หารอีก 8 เพื่อจะได้ความถี่ PWM ขนาด 3.9 Khz   
   cbi (TCCR1B, CS10);
   sbi (TCCR1B, CS11);
   cbi (TCCR1B, CS12);

// Timer1 PWM Mode set to Phase Correct PWM
   cbi (TCCR1A, COM1A0); // ตั้งค่าให้ชุดส่งสัญญาณช่อง 2(OCR1A) ให้ส่งสัญญาณออกเป็น Sine PWM ปรกติ +
   sbi (TCCR1A, COM1A1);
   sbi (TCCR1A, COM1B0); // ตั้งค่าให้ชุดส่งสัญญาณช่อง 2(OCR1B)  ให้ส่งสัญญาณออกเป็น Sine PWM กลับเฟส Invert เป็น -
   sbi (TCCR1A, COM1B1);
   sbi (TCCR1A, WGM10); //ตั้งค่าให้สัญญาณพัลซ์ทุกลูกอยู่แนวเดียวกันเสมอในทุกเฟส (Mode 1 / Phase Correct PWM)
   cbi (TCCR1A, WGM11);
   cbi (TCCR1B, WGM12);
   cbi (TCCR1B, WGM13);
}

//------------------------------------------------------------------------------
// timer2 setup
// set prescaler to 8, PWM mode to phase correct PWM, 16000000/512/8 = 3.9kHz clock ให้เหมาะกับ IPM เบอร์เก่า ๆ
void setup_timer2(void){
// Timer1 Clock Prescaler to :ตั้งค่าไทม์เมอร์ให้ หารอีก 8 เพื่อจะได้ความถี่ PWM ขนาด 3.9 Khz  
   // Timer2 Clock Prescaler to : /8
   cbi (TCCR2B, CS20);
   sbi (TCCR2B, CS21);
   cbi (TCCR2B, CS22);

// Timer2 PWM Mode set to Phase Correct PWM
   cbi (TCCR2A, COM2A0); // ตั้งค่าให้ชุดส่งสัญญาณช่อง 3(OCR2A) ให้ส่งสัญญาณออกเป็น Sine PWM ปรกติ +
   sbi (TCCR2A, COM2A1);
   sbi (TCCR2A, COM2B0); // ตั้งค่าให้ชุดส่งสัญญาณช่อง 3(OCR2B)  ให้ส่งสัญญาณออกเป็น Sine PWM กลับเฟส Invert เป็น -
   sbi (TCCR2A, COM2B1);
   sbi (TCCR2A, WGM20); //ตั้งค่าให้สัญญาณพัลซ์ทุกลูกอยู่แนวเดียวกันเสมอในทุกเฟส (Mode 1 / Phase Correct PWM)
   cbi (TCCR2A, WGM21);
   cbi (TCCR2B, WGM22);
}
//------------------------------------------------------------------------------
//การที่จะได้สัญญาณ ซายเวฟ ที่มีความถี่แม่นยำตามที่เราตั้งค่าต่าง ๆ ไว้ ต้องอาศัยการนับเวลาของตัวไทม์ เมอร์ 2 และเมื่อนับครบตามที่เราตั้งไว้ต้องมาทำตามคำสั่งชุดนี้
// Timer2 Interrupt Service at 31372,550 KHz = 32uSec
// this is the timebase REFCLOCK for the DDS generator
// runtime : 8 microseconds ( inclusive push and pop)

ISR(TIMER2_OVF_vect) {
   // สูตรการคำนวน  ความถี่กลับมา แล้วเลื่อน จาก 32 บิต กลับมาใช้เพียง 8 บิตล่าง  
	sigma=sigma+delta; // soft DDS, phase accu with 32 bits
	phase0=sigma >> 24;     // use upper 8 bits for phase accu as frequency information
	
   //ชุดคำสั่งนี้แบ่งเป็น 2 ส่วน  ชุดแรกเพื่อ ส่งสัญญาณ ซายเวฟ ทั้ง 3 คู่ ให้มีเฟสต่างกัน 0-90-180 เพื่อใช้กับมอร์เตอร์ซิงเกิ้ลเฟส และ ชุดต่อมา สำหรับ 3 เฟส 0-120-120
                         
    if (single == true){      // ถ้าจั้มเปอร์เป็นจริง ให้ทำงานส่วนนี้  คือแบบซิงเกิลเฟส                 
      phase1 = phase0 +127 ;  // ค่าเฟส 1
      phase2 = phase0 +63 ;  // ค่าเฟส  2 
	//สำหรับแบบซิงเกิ้ลเฟส เฟสคู่ที่ 0 กับ เฟสคู่ที่ 1 จะกลับกัน เพื่อให้มอร์เตอร์ หมุนทิศทางเดียวกันทั้งแบบ ซิงเกิ้ล และ แบบ 3 เฟส
	// นำค่าที่อ่านได้จากตาราง ซายเวฟ + ความแรงของสัญญาณ (Amplitude) + เฟส + ค่า DeadTime ออกไปที่ ขาสัญญาณออกทั้ง 3 คู่
      OCR0A=(uint8_t)pgm_read_byte_near((Sine_Table + ADD_AMPD) + phase1)+DT_LOW;  // pin D6
      OCR0B=(uint8_t)pgm_read_byte_near((Sine_Table + ADD_AMPD) + phase1)+DT_HIGH;  // pin D5

      OCR1A=(uint8_t)pgm_read_byte_near((Sine_Table + ADD_AMPD) + phase0)+DT_LOW;  // pin D9
      OCR1B=(uint8_t)pgm_read_byte_near((Sine_Table + ADD_AMPD) + phase0)+DT_HIGH;  // pin D10
    
      OCR2A=(uint8_t)pgm_read_byte_near((Sine_Table + ADD_AMPD) + phase2)+DT_LOW;  // pin D11
      OCR2B=(uint8_t)pgm_read_byte_near((Sine_Table + ADD_AMPD) + phase2)+DT_HIGH;  // pin D3 
    }
	//---------------------- ถ้าจั้มเปอร์เป็นจริง ให้ทำงานส่วนนี้  คือแบบ 3 เฟส  ที่มีเฟสต่างกัน 120 องศา------------------------------------------------------------------
    else{
      phase1 = phase0 +85 ;  //  ค่าเฟส 1
      phase2 = phase0 +170 ;   // ค่าเฟส  2
   // นำค่าที่อ่านได้จากตาราง ซายเวฟ + ความแรงของสัญญาณ (Amplitude) + เฟส + ค่า DeadTime ออกไปที่ ขาสัญญาณออกทั้ง 3 คู่
      OCR0A=(uint8_t)pgm_read_byte_near((Sine_Table + ADD_AMPD) + phase0)+DT_LOW;  // pin D6
      OCR0B=(uint8_t)pgm_read_byte_near((Sine_Table + ADD_AMPD) + phase0)+DT_HIGH;  // pin D5

      OCR1A=(uint8_t)pgm_read_byte_near((Sine_Table + ADD_AMPD) + phase1)+DT_LOW;  // pin D9
      OCR1B=(uint8_t)pgm_read_byte_near((Sine_Table + ADD_AMPD) + phase1)+DT_HIGH;  // pin D10
    
      OCR2A=(uint8_t)pgm_read_byte_near((Sine_Table + ADD_AMPD) + phase2)+DT_LOW;  // pin D11
      OCR2B=(uint8_t)pgm_read_byte_near((Sine_Table + ADD_AMPD) + phase2)+DT_HIGH;  // pin D3       
    }
} 
//จบโปรแกรมแล้วครับใครจะเขียนเพิ่มเติมอะไรได้ครับ แต่อย่าลืมให้เครดิตผู้ที่เขียนต้นฉบับด้วยครับ


